## sdkconfig.defaults
```kconfig
# Flash
CONFIG_ESPTOOLPY_FLASHSIZE_4MB=y
CONFIG_ESPTOOLPY_FLASHMODE_DIO=y
CONFIG_ESPTOOLPY_FLASHFREQ_80M=y

# CPU
CONFIG_ESP_DEFAULT_CPU_FREQ_MHZ_160=y

# Partition table
CONFIG_PARTITION_TABLE_CUSTOM=y
CONFIG_PARTITION_TABLE_CUSTOM_FILENAME="partitions.csv"

# Bluetooth - NimBLE
CONFIG_BT_ENABLED=y
CONFIG_BT_NIMBLE_ENABLED=y
CONFIG_BT_NIMBLE_50_FEATURE_SUPPORT=n
CONFIG_BT_NIMBLE_EXT_ADV=n
CONFIG_BT_NIMBLE_MAX_CONNECTIONS=1
CONFIG_BT_NIMBLE_ROLE_CENTRAL=y
CONFIG_BT_NIMBLE_ROLE_OBSERVER=y
CONFIG_BT_NIMBLE_ROLE_PERIPHERAL=y
CONFIG_BT_NIMBLE_ROLE_BROADCASTER=y

# WiFi
CONFIG_ESP_WIFI_SOFTAP_SUPPORT=y

# HTTP server
CONFIG_HTTPD_WS_SUPPORT=y
CONFIG_HTTPD_MAX_URI_HANDLERS=16
CONFIG_HTTPD_MAX_REQ_HDR_LEN=1024

# Networking
CONFIG_LWIP_MAX_SOCKETS=16

# Coexistence
CONFIG_ESP_COEX_SW_COEXIST_ENABLE=y

# Logging
CONFIG_LOG_DEFAULT_LEVEL_INFO=y

# FreeRTOS
CONFIG_FREERTOS_HZ=1000

# Main task needs larger stack for WiFi+BLE+HTTP init chain
CONFIG_ESP_MAIN_TASK_STACK_SIZE=8192

# ── Memory optimisation for TLS ──
# Shrink per-session TLS record buffers (default IN=16384)
CONFIG_MBEDTLS_SSL_IN_CONTENT_LEN=4096
CONFIG_MBEDTLS_SSL_OUT_CONTENT_LEN=4096
# Shrink buffers after handshake to actual record size
CONFIG_MBEDTLS_SSL_VARIABLE_BUFFER_LENGTH=y
# Dynamic per-record allocation instead of per-session
CONFIG_MBEDTLS_DYNAMIC_BUFFER=y
# No need to keep full peer cert in RAM (we are a server)
CONFIG_MBEDTLS_SSL_KEEP_PEER_CERTIFICATE=n
# Device is server-only; drop the CA bundle entirely
CONFIG_MBEDTLS_CERTIFICATE_BUNDLE=n
# Strip unused ECC curves — keep secp256r1 + curve25519 only
CONFIG_MBEDTLS_ECP_DP_SECP192R1_ENABLED=n
CONFIG_MBEDTLS_ECP_DP_SECP224R1_ENABLED=n
CONFIG_MBEDTLS_ECP_DP_SECP384R1_ENABLED=n
CONFIG_MBEDTLS_ECP_DP_SECP521R1_ENABLED=n
CONFIG_MBEDTLS_ECP_DP_SECP192K1_ENABLED=n
CONFIG_MBEDTLS_ECP_DP_SECP224K1_ENABLED=n
CONFIG_MBEDTLS_ECP_DP_SECP256K1_ENABLED=n
CONFIG_MBEDTLS_ECP_DP_BP256R1_ENABLED=n
CONFIG_MBEDTLS_ECP_DP_BP384R1_ENABLED=n
CONFIG_MBEDTLS_ECP_DP_BP512R1_ENABLED=n
# Disable unused TLS features
CONFIG_MBEDTLS_PEM_WRITE_C=n
CONFIG_MBEDTLS_X509_CRL_PARSE_C=n
CONFIG_MBEDTLS_X509_CSR_PARSE_C=n

# ── FAT filesystem (microSD) ──
# 512-byte sectors for Windows/macOS/Linux compatibility
CONFIG_FATFS_SECTOR_512=y
# Enable long filenames (heap-allocated — ~600 B per open file)
CONFIG_FATFS_LFN_HEAP=y

# Reduce system socket pool
CONFIG_LWIP_MAX_SOCKETS=10
```
